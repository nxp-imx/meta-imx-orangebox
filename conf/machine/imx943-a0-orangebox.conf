## conf/machine/imx943-orangebox.conf
```bitbake
require conf/machine/include/imx943-evk.inc

KERNEL_DEVICETREE = " \
    freescale/imx943-orangebox.dtb \
    freescale/imx943-orangebox-mic.dtb \
"

KERNEL_DEVICETREE:append:use-nxp-bsp = ""

UBOOT_CONFIG[sd]   = "imx943_orangebox_defconfig,sdcard"
UBOOT_CONFIG[xspi]= "imx943_orangebox_xspi_defconfig"

OEI_BOARD  ?= "mx943lp5-19"

DDR_TYPE   = "lpddr5"

DDR_FIRMWARE_NAME = " \
    lpddr5_dmem_v202409.bin \
    lpddr5_dmem_qb_v202409.bin \
    lpddr5_imem_v202409.bin \
    lpddr5_imem_qb_v202409.bin \
"
OEI_DDR_CONFIG     = "MIMX943_LPDDR5_EVK_19X19_4266MTS_FW2024.09_timing"
OEI_DDR_CONFIG_ECC = "MIMX943_LPDDR5_EVK_19X19_4266MTS_FW2024.09_ECC_enabled_timing"

WKS_FILE_DEPENDS:append:imx-nxp-bsp = " imx-mcore-demos"
IMAGE_BOOT_FILES:append = " \
    mcore-demos/imx943_orangebox_cm33_core1_TCM_hello_world.bin \
    mcore-demos/imx943_orangebox_cm33_core1_TCM_rpmsg_lite_pingpong_rtos_linux_remote.bin \
    mcore-demos/imx943_orangebox_cm33_core1_TCM_rpmsg_lite_str_echo_rtos.bin \
    mcore-demos/imx943_orangebox_cm7_core0_TCM_hello_world.bin \
    mcore-demos/imx943_orangebox_cm7_core0_TCM_rpmsg_lite_pingpong_rtos_linux_remote.bin \
    mcore-demos/imx943_orangebox_cm7_core0_TCM_rpmsg_lite_str_echo_rtos.bin \
    mcore-demos/imx943_orangebox_cm7_core1_TCM_hello_world.bin \
    mcore-demos/imx943_orangebox_cm7_core1_TCM_rpmsg_lite_pingpong_rtos_linux_remote.bin \
    mcore-demos/imx943_orangebox_cm7_core1_TCM_rpmsg_lite_str_echo_rtos.bin \
"
```
