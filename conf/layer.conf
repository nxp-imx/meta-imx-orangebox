## conf/layer.conf
```bitbake
# We have a conf and classes directory, add to BBPATH
BBPATH .= ":${LAYERDIR}"

# We have a packages directory, add to BBFILES
BBFILES += "${LAYERDIR}/recipes-*/*/*.bb \
            ${LAYERDIR}/recipes-*/*/*.bbappend"

BBFILE_COLLECTIONS += "orangebox"
BBFILE_PATTERN_orangebox := "^${LAYERDIR}/"
BBFILE_PRIORITY_orangebox = "8"
LAYERSERIES_COMPAT_orangebox = "kirkstone langdale mickledore"
```

## conf/machine/imx8dxl-orangebox.conf
```bitbake
#@TYPE: Machine
#@NAME: 8DXL OrangeBox
#@DESCRIPTION: i.MX 8DualXLite OrangeBox Automotive Connectivity Domain Controller (CDC) Development Platform
#@MAINTAINER: Alexandra Safta <alexandra-ioana.safta@nxp.com>

MACHINEOVERRIDES =. "mx8dxl:"

require conf/machine/include/imx-base.inc
require conf/machine/include/arm/armv8a/tune-cortexa35.inc

IMX_SOC_REV = "B0"

IMX_DEFAULT_BSP = "nxp"

MACHINE_FEATURES += "pci bcm43455 bcm4356 nxp8997-pcie nxp9098-pcie"
MACHINE_FEATURES:append:use-nxp-bsp = " bcm4359"

# Don't include kernels in standard images
RRECOMMENDS:${KERNEL_PACKAGE_NAME}-base = ""

LOADADDR = ""

# Disable the serial console due to auto-serial-console
SERIAL_CONSOLES = "115200;ttyLP0"

# we do not want to have getty running on tty1 as we run
# auto-serial-console there
USE_VT = "0"

KERNEL_DEVICETREE = " \
    freescale/${MACHINE}.dtb \
    freescale/${MACHINE}-sd.dtb \
"

ATF_PLATFORM = "imx8dxl"
IMX_BOOT_SOC_TARGET = "iMX8DXL"

# This machine is not supported by u-boot-fslc, so we force it to use
# u-boot-imx here.
IMX_DEFAULT_BOOTLOADER = "u-boot-imx"

UBOOT_MAKE_TARGET = "all"
SPL_BINARY = "spl/u-boot-spl.bin"
UBOOT_SUFFIX = "bin"

UBOOT_CONFIG_BASENAME = "imx8dxl_orangebox"

UBOOT_CONFIG ??= "sd"
UBOOT_CONFIG[sd] = "${UBOOT_CONFIG_BASENAME}_defconfig,sdcard"
UBOOT_CONFIG[fspi]= "${UBOOT_CONFIG_BASENAME}_fspi_defconfig"
UBOOT_CONFIG[lcd] = "${UBOOT_CONFIG_BASENAME}_lcd_defconfig"


IMX_BOOT_SEEK = "32"

IMXBOOT_TARGETS = "flash_spl flash_spl_flexspi"

BOARD_TYPE = "ob"

PREFERRED_PROVIDER_imx-sc-firmware = "imx-scfw-porting-kit"
```
